## main/Kconfig.projbuild
```kconfig
menu "Example Configuration"

    config EXAMPLE_HCI_UART_BAUDRATE
        int "UART Baudrate for HCI"
        range 115200 3000000
        default 115200
        help
            UART Baudrate for HCI. Please use standard baudrate.

    config EXAMPLE_HCI_UART_FLOW_CTRL_ENABLE
        bool "Enable HCI UART flow control"
        default y
        help
            Enable/disable HCI UART flow control

    config EXAMPLE_HCI_HIDE_BLE5_ADV
        bool "Hide LE Extended/Periodic Advertising from the host"
        default n
        help
            Clear the LE Extended Advertising and LE Periodic Advertising bits
            of the LE Read Local Supported Features response. The Linux kernel
            then only uses legacy advertising, scanning and connection commands.

            Needed by applications that send legacy advertising commands on a
            raw HCI socket (Qt Bluetooth kernel peripheral backend), which
            otherwise get "Command Disallowed".

            Drawback: devices that only use extended advertising are not seen
            by the host. Leave disabled when the host only scans and connects.

endmenu
```

## sdkconfig.defaults
```kconfig
CONFIG_IDF_TARGET="esp32c6"
CONFIG_BT_ENABLED=y
CONFIG_BT_CONTROLLER_ONLY=y
CONFIG_BT_CONTROLLER_ENABLED=y
```
